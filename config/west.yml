## config/west.yml
```yaml
manifest:
  remotes:
      # zmk official
    - name: zmkfirmware
      url-base: https://github.com/zmkfirmware
    - name: chance                         #new entry
      url-base: https://github.com/teenageninja637-ai  #new entry
  projects:
    - name: zmk
      remote: zmkfirmware
      revision: main
      import: app/west.yml
    - name: zmk-test02                 #new entry
      remote: chance                       #new entry
      revision: main                      #new entry
  self:
    path: config
```
